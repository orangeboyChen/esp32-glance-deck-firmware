## firmware/sdkconfig.defaults
```kconfig
CONFIG_IDF_TARGET="esp32s3"
CONFIG_ESP_WIFI_SOFTAP_SUPPORT=y
CONFIG_MQTT_PROTOCOL_311=y
CONFIG_MBEDTLS_CERTIFICATE_BUNDLE=y
CONFIG_ESP_TLS_USING_MBEDTLS=y
```

## sdkconfig.defaults
```kconfig
CONFIG_IDF_TARGET="esp32s3"
CONFIG_ESP_MAIN_TASK_STACK_SIZE=20000
CONFIG_ESPTOOLPY_FLASHSIZE_16MB=y
CONFIG_ESP_WIFI_SOFTAP_SUPPORT=y
CONFIG_MQTT_PROTOCOL_311=y
CONFIG_MBEDTLS_CERTIFICATE_BUNDLE=y
CONFIG_ESP_TLS_USING_MBEDTLS=y
CONFIG_PARTITION_TABLE_CUSTOM=y
CONFIG_PARTITION_TABLE_CUSTOM_FILENAME="partitions.csv"
CONFIG_BOOTLOADER_APP_ROLLBACK_ENABLE=y
CONFIG_SPIFFS_MAX_PARTITIONS=1
CONFIG_SPIFFS_OBJ_NAME_LEN=64
CONFIG_SPIFFS_USE_MAGIC=y
CONFIG_SPIFFS_USE_MAGIC_LENGTH=y
```
